## sdkconfig.defaults
```kconfig
CONFIG_FREERTOS_ENABLE_TASK_SNAPSHOT=0   
CONFIG_FREERTOS_DEBUG_OCDAWARE=0      
CONFIG_ESP32S3_DEBUG_OCDAWARE=0        
CONFIG_USB_ENABLED=0  
CONFIG_ESP_CONSOLE_SECONDARY_USB_SERIAL_JTAG=0
CONFIG_USB_OTG_SUPPORTED=0
CONFIG_USB_HOST_CONTROL_TRANSFER_MAX_SIZE=0
CONFIG_USB_HOST_HW_BUFFER_BIAS_BALANCED=0
CONFIG_USB_HOST_DEBOUNCE_DELAY_MS=0
CONFIG_USB_HOST_RESET_HOLD_MS=0
CONFIG_USB_HOST_RESET_RECOVERY_MS=0
CONFIG_USB_HOST_SET_ADDR_RECOVERY_MS=0
CONFIG_SPIRAM_SIZE=8388608
CONFIG_ESP_COREDUMP_ENABLE_TO_FLASH=0
CONFIG_ESP32_WIFI_DYNAMIC_RX_BUFFER_NUM=10
CONFIG_ESP32_WIFI_DYNAMIC_TX_BUFFER_NUM=10
```
